## Kconfig
```kconfig
# SPDX-License-Identifier: MIT

config ZMK_DYNAMIC_ENCODER
	bool
	default y if DT_HAS_SEKIGON_DYNAMIC_ENCODER_SOURCE_ENABLED
	default n
	help
	  Enable the runtime sensor binding provider dispatch hook.

config ZMK_DYNAMIC_ENCODER_RUNTIME
	bool "nemu-link per-layer encoder assignments"
	depends on ZMK_STUDIO_RPC
	depends on ZMK_DYNAMIC_SETTINGS
	depends on ZMK_BEHAVIOR_LOCAL_IDS
	depends on DT_HAS_SEKIGON_DYNAMIC_ENCODER_SOURCE_ENABLED
	default y
	select ZMK_DYNAMIC_ENCODER
	help
	  Enable runtime assignments for regular encoder sources edited from the Keymap view.
	  High-resolution dial sources are provided by the high-resolution dial driver.
```

## dts/bindings/behaviors/sekigon,dynamic-behavior-runtime-encoder.yaml
```yaml
# SPDX-License-Identifier: MIT

description: Runtime sensor encoder adapter
compatible: "sekigon,dynamic-behavior-runtime-encoder"
include: zero_param.yaml
```

## dts/bindings/sekigon,dynamic-encoder-source.yaml
```yaml
# SPDX-License-Identifier: MIT

description: Runtime sensor binding source expanded across all keymap layers
compatible: "sekigon,dynamic-encoder-source"
properties:
  source-name:
    type: string
    required: true
  label:
    type: string
    required: true
  sensor:
    type: phandle
    required: true
  sensor-index:
    type: int
    required: true
  input-mode:
    type: string
    required: true
    enum: [tick, angle]
  target-role:
    type: string
    required: true
  default-cw-binding:
    type: phandle-array
    specifier-space: binding
    description: Initial clockwise Behavior binding for runtime encoder sources.
  default-ccw-binding:
    type: phandle-array
    specifier-space: binding
    description: Initial counter-clockwise Behavior binding for runtime encoder sources.
```
